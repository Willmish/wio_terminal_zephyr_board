## wio_terminal_defconfig
```kconfig
# SPDX-License-Identifier: Apache-2.0

CONFIG_SOC_SERIES_SAMD51=y
CONFIG_SOC_PART_NUMBER_SAMD51P19A=y
CONFIG_BOARD_WIO_TERMINAL=y
CONFIG_SOC_ATMEL_SAMD5X_OSCULP32K_AS_MAIN=y

CONFIG_CORTEX_M_SYSTICK=y
CONFIG_ARM_MPU=y

CONFIG_PINMUX=y
# Enable uart driver
CONFIG_SERIAL=y

CONFIG_USB_CDC_ACM=y
# Enable console
CONFIG_CONSOLE=y
CONFIG_UART_CONSOLE=y
CONFIG_USB_DEVICE_STACK=y
CONFIG_USB_UART_CONSOLE=y
CONFIG_UART_INTERRUPT_DRIVEN=y

CONFIG_BOOTLOADER_BOSSA=y
CONFIG_BOOTLOADER_BOSSA_ADAFRUIT_UF2=y
```
